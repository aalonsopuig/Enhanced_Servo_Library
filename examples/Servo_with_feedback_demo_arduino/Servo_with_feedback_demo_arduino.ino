/*
===============================================================================
Name:         Servo_with_feedback_demo_arduino
Version:      1.0.0
Author:       Alejandro Alonso Puig + GPT
GitHub:       https://github.com/aalonsopuig
Date:         2026-03-10
License:      Apache 2.0
-------------------------------------------------------------------------------

Description:

Example demonstrating how to use the ServoController library with
a servo that provides analog position feedback from its internal potentiometer.

The example uses:

- one servo
- one feedback signal from the internal potentiometer
- three user potentiometers

Controls:

A0 -> Target angle (0..180 degrees)
A1 -> Speed percentage (1..100%)
A2 -> Acceleration percentage (1..100%)

Feedback:

A4 -> Servo internal potentiometer (analog feedback)

The program prints the following information through USB serial:

Target | Cmd | Meas | Err | Speed% | Accel%

Where:

Target  = user requested angle
Cmd     = commanded reference generated by the motion profile
Meas    = angle measured from the feedback potentiometer
Err     = difference between commanded and measured angle

Hardware notes:

The servo must be powered from an external power supply.
Do NOT power high torque servos directly from the Arduino 5V pin.

===============================================================================
*/

#include <Arduino.h>
#include "ServoController.h"


// ============================================================================
// Pins
// ============================================================================

// Potentiometers controlling the motion parameters
#define POT_TARGET_PIN   A0
#define POT_SPEED_PIN    A1
#define POT_ACCEL_PIN    A2

// Analog feedback from the servo potentiometer
#define SERVO_FEEDBACK_PIN A4

// Servo PWM output
#define SERVO_PIN 9


// ============================================================================
// ADC helpers
// ============================================================================

// Arduino ADC is 10-bit
#define ADC_SCALE 1023.0f

// Number of samples used to average potentiometer readings
#define POT_SAMPLES 4


// ============================================================================
// Servo physical characterization
// ============================================================================
//
// Example values measured on a Hitec HS-805BB
//
// PWM range observed:
// 700 µs -> 0°
// 2400 µs -> 180°
//
// Feedback ADC range observed:
// ADC 101 -> 0°
// ADC 383 -> 180°
//

#define SERVO_MIN_DEG   0.0f
#define SERVO_MAX_DEG   180.0f

#define PWM_MIN_US      700
#define PWM_MAX_US      2400

#define FB_ADC_MIN      101
#define FB_ADC_MAX      383

// Maximum physical speed measured or estimated for the servo
#define SERVO_MAX_SPEED_DEGPS  17.5f


// ============================================================================
// Motion defaults
// ============================================================================

#define DEFAULT_SPEED_PCT  50
#define DEFAULT_ACCEL_PCT  50

// Rest position used at startup
#define REST_DEG 90.0f


// ============================================================================
// Global objects
// ============================================================================

ServoConfig servoCfg;
ServoController servo;


// ============================================================================
// Utility functions
// ============================================================================

// Clamp helper
static inline float clampf(float x,float lo,float hi)
{
  if(x<lo) return lo;
  if(x>hi) return hi;
  return x;
}


// Average multiple ADC samples to reduce noise
float readAveragedADC(uint8_t pin,int samples)
{
  long sum=0;

  for(int i=0;i<samples;i++)
  {
    sum+=analogRead(pin);
  }

  return (float)sum/samples;
}


// Convert ADC value to target angle
float targetDegFromAdc(float adc)
{
  float deg=(adc/ADC_SCALE)*180.0f;

  return clampf(deg,0.0f,180.0f);
}


// Convert ADC value to percentage
uint8_t percentFromAdc(float adc)
{
  float t=clampf(adc/ADC_SCALE,0.0f,1.0f);

  int pct=(int)(1.0f+t*99.0f+0.5f);

  if(pct<1) pct=1;
  if(pct>100) pct=100;

  return (uint8_t)pct;
}


// ============================================================================
// Setup
// ============================================================================

void setup()
{
  Serial.begin(115200);
  delay(500);

  // ------------------------------------------------------------
  // Configure the servo parameters
  // ------------------------------------------------------------

  servoCfg.name="Servo1";

  servoCfg.pwm_pin=SERVO_PIN;

  servoCfg.servo_min_deg=SERVO_MIN_DEG;
  servoCfg.servo_max_deg=SERVO_MAX_DEG;

  servoCfg.allowed_min_deg=SERVO_MIN_DEG;
  servoCfg.allowed_max_deg=SERVO_MAX_DEG;

  servoCfg.rest_deg=REST_DEG;

  servoCfg.pwm_min_us=PWM_MIN_US;
  servoCfg.pwm_max_us=PWM_MAX_US;

  servoCfg.max_speed_degps=SERVO_MAX_SPEED_DEGPS;

  servoCfg.default_speed_pct=DEFAULT_SPEED_PCT;
  servoCfg.default_accel_pct=DEFAULT_ACCEL_PCT;

  // Enable feedback
  servoCfg.feedback_adc_pin=SERVO_FEEDBACK_PIN;

  servoCfg.fb_adc_at_servo_min_deg=FB_ADC_MIN;
  servoCfg.fb_adc_at_servo_max_deg=FB_ADC_MAX;

  servoCfg.inverted=false;

  servoCfg.fault_detection_enabled=false;

  // ------------------------------------------------------------
  // Initialize controller
  // ------------------------------------------------------------

  servo.begin(servoCfg);

  // Synchronize the internal state of the controller
  // with the actual measured servo position.
  servo.syncToFeedback();

  Serial.println("Servo with feedback demo");
  Serial.println("Target | Cmd | Meas | Err | Speed% | Accel%");
}


// ============================================================================
// Main loop
// ============================================================================

void loop()
{
  // ------------------------------------------------------------
  // Read potentiometers
  // ------------------------------------------------------------

  float adcTarget=readAveragedADC(POT_TARGET_PIN,POT_SAMPLES);
  float adcSpeed =readAveragedADC(POT_SPEED_PIN,POT_SAMPLES);
  float adcAccel =readAveragedADC(POT_ACCEL_PIN,POT_SAMPLES);

  float targetDeg=targetDegFromAdc(adcTarget);
  uint8_t speedPct=percentFromAdc(adcSpeed);
  uint8_t accelPct=percentFromAdc(adcAccel);

  // ------------------------------------------------------------
  // Send motion command to controller
  // ------------------------------------------------------------

  servo.setTarget(targetDeg,speedPct,accelPct);

  // ------------------------------------------------------------
  // Update motion profile
  // ------------------------------------------------------------

  servo.update();

  // ------------------------------------------------------------
  // Retrieve current data
  // ------------------------------------------------------------

  float cmd  = servo.getCommandDeg();
  float meas = servo.getMeasuredDeg();
  float err  = cmd - meas;  

  // ------------------------------------------------------------
  // Print telemetry
  // ------------------------------------------------------------

  Serial.print(targetDeg,1);
  Serial.print(" | ");

  Serial.print(cmd,1);
  Serial.print(" | ");

  Serial.print(meas,1);
  Serial.print(" | ");

  Serial.print(err,1);
  Serial.print(" | ");

  Serial.print(speedPct);
  Serial.print(" | ");

  Serial.println(accelPct);

  delay(20);
}
